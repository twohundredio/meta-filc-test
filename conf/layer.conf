## conf/layer.conf
```bitbake
BBPATH .= ":${LAYERDIR}"

BBFILES += "${LAYERDIR}/recipes-*/*/*.bb \
            ${LAYERDIR}/recipes-*/*/*.bbappend"

BBFILE_COLLECTIONS += "filc"
BBFILE_PATTERN_filc = "^${LAYERDIR}/"
BBFILE_PRIORITY_filc = "6"

LAYERDEPENDS_filc = "core"
LAYERSERIES_COMPAT_filc = "wrynose"

require conf/nonfilcable.conf
```
